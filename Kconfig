## Kconfig
```kconfig
#
# For a description of the syntax of this configuration file,
# see the file kconfig-language.txt in the NuttX tools repository.
#

config TELEPHONY
	tristate "Enable telephony library"
	default n
	depends on LIBUV && LIB_DBUS
	---help---
		Enable telephony library

if TELEPHONY

config MODEM_ACTIVE_COUNT
	int "active modem count"
	default 1
	range 1 2

config MODEM_PATH
	string "modem path"
	default "/ril_0"
	---help---
		The modem path

config MODEM_PATH_2
	string "modem path 2"
	default "/ril_1"
	depends on MODEM_ACTIVE_COUNT = 2
	---help---
		The modem path 2

config MODEM_ABNORMAL_EVENT
	bool "support modem abnormal event"
	default y
	---help---
		enable/disable modem abnormal event feature

config TELEPHONY_TOOL
	bool "Telephony tool"
	default n

if TELEPHONY_TOOL

config TELEPHONY_TOOL_STACKSIZE
	int "Telephony tool stack size"
	default 16384

config TELEPHONY_TOOL_PRIORITY
	int "Telephony tool priority"
	default 100

endif
endif
```
